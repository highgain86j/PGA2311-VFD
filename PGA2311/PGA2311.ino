#include <GU7K.h>
GU7K_Serial_Async interface(38400,2, 3, 4); // BAUD RATE,SIN,BUSY,RESET
//GU7K_Serial_Sync interface(3, 5, 6, 7); // SIN,BUSY,SCK,RESET
//GU7K_Serial_SPI interface(3, 5, 6, 7, 8); // SIN,BUSY,SCK,RESET,CS
//GU7K_Parallel interface('R', 8,9,10,11, 0,1,2,3,4,5,6,7); // Module Pin#3=RESET; BUSY,RESET,WR,RD,D0-D7
//GU7K_Parallel interface('B', 8,9,10,11, 0,1,2,3,4,5,6,7); // Module Pin#3=BUSY; BUSY,RESET,WR,RD,D0-D7
//GU7K_Parallel interface('N', 8,9,10,11, 0,1,2,3,4,5,6,7); // Module Pin#3=nothing; BUSY,RESET,WR,RD,D0-D7

Noritake_VFD_GU7K vfd;

const int analogInPin = A3;  // Analog input pin that the potentiometer is attached to
const int analogOutPin = 11; // Analog output pin that the LED is attached to
const int WarnLed =  13;      // 
const int DownPin =  6;      // 
const int UpPin =  7;      // 

const uint8_t att_value[256] = {
  0x00,0x00,0x1F,0x2E,0x39,0x41,0x47,0x4D,0x52,0x56,0x5A,0x5D,0x61,0x63,0x66,0x69,
  0x6B,0x6D,0x6F,0x71,0x73,0x75,0x77,0x78,0x7A,0x7B,0x7D,0x7E,0x7F,0x81,0x82,0x83,
  0x84,0x85,0x86,0x87,0x88,0x89,0x8A,0x8B,0x8C,0x8D,0x8E,0x8F,0x90,0x91,0x91,0x92,
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  0xCD,0xCD,0xCE,0xCE,0xCE,0xCE,0xCE,0xCE,0xCE,0xCF,0xCF,0xCF,0xCF,0xCF,0xCF,0xD0
  };





int ValueSensor = 0;        // value read from the pot
int Value2311 = 0;        // value output to the PWM (analog out)
int ValueLED = 0;        // value output to the PWM (analog out)
int ValueVFD = 0;        // value output to the PWM (analog out)

char outbuff[2][40] = {0};

void atrc_logo(long timeout){
  const static uint8_t PROGMEM image[] = {
    0x00,0x00,0x00,0x00,0x10,0x02,0x12,0xc2,0x15,0x24,0x15,0x24,0x15,0x28,0x15,0x30,
    0x3f,0xfe,0x15,0x30,0x15,0x28,0x15,0x24,0x17,0xe4,0x10,0x02,0x10,0x02,0x00,0x02,
    0x00,0x00,0x10,0x00,0x10,0x04,0x13,0xc8,0x12,0x50,0x12,0x42,0x12,0x42,0x32,0x7e,
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    0x00,0x00,0x00,0x00,0x00,0x00,0x00,0x00,0x00,0x00,0x00,0x00,0x00,0x00,0x00,0x00
  };
  vfd.GU7K_drawImage_p(280, 16, image);
    delay(timeout);
    vfd.GU7K_setScreenBrightness (10);
    delay(500);
}

void warn(){
  static int warnval[2];
  warnval[1] = ValueSensor;
 if ( !(warnval[0] == warnval[1]) ) {
    if ( ValueSensor > 511 ) {
          digitalWrite(WarnLed, HIGH);
    }
    if ( ValueSensor < 512 ) {
         digitalWrite(WarnLed, LOW);
    }
  };
  warnval[0] = warnval[1];
}

void warn2(){
  static int warnval[2];
  warnval[1] = ValueSensor;
 if ( !(warnval[0] == warnval[1]) ) {
    if ( ValueSensor > 511 ) {
          vfd.GU7K_setScreenBrightness (100);
    }
    if ( ValueSensor < 512 ) {
         vfd.GU7K_setScreenBrightness (10);
    }
  };
  warnval[0] = warnval[1];
}


void autorun(){
  static boolean volup = true;
  if ( volup ) {      
    //Serial.print("\n<Auto  -  Up> ");
    digitalWrite(UpPin, HIGH);   // turn the LED on (HIGH is the voltage level)
    if ( ValueSensor == 1023 ) {
      digitalWrite(UpPin, LOW);
      volup = false;
      delay(2000);   
    };
  }
  if ( !volup ){
    //Serial.print("\n<Auto - Down> ");
    digitalWrite(DownPin, HIGH);   // turn the LED on (HIGH is the voltage level)
    if ( ValueSensor == 0 ) {
      digitalWrite(DownPin, LOW);    // turn the LED off by making the voltage LOW
      volup = true;  
      delay(2000);
    };
  }
  //Serial.print("sensor:");
  //Serial.print(ValueSensor);
  //Serial.print("   ");
  //Serial.print("\t");
  //Serial.print("output:");
  //Serial.print(Value2311);
}


void setup() {
    // initialize serial communications at 9600 bps:
    pinMode(analogInPin, INPUT);
    pinMode(WarnLed, OUTPUT);
    digitalWrite(WarnLed, LOW);
    pinMode(DownPin, OUTPUT);
    digitalWrite(DownPin, LOW);
    pinMode(UpPin, OUTPUT);
    digitalWrite(UpPin, LOW);
    Serial.begin(115200);
    _delay_ms(500);           // wait for device to power up
    vfd.begin(280, 16);       // 140x16 module
    // Enter the 4-digit model class number
    // E.g. 7040 for GU140X16G-7040A
    vfd.interface(interface); // select which interface to use
    vfd.isModelClass(7000);
    //vfd.isGeneration('B');    // Uncomment this for B generation
    vfd.GU7K_reset();       // reset module
    vfd.GU7K_init();        // initialize module
    atrc_logo(2500);
    vfd.GU7K_setScreenBrightness (10);
    vfd.GU7K_clearScreen();
}

void LEDBright(){
  analogWrite(analogOutPin, ValueLED);
}

void VFDBright(){
  vfd.GU7K_setScreenBrightness (ValueVFD);
}

void loop() {
  // read the analog in value:
  ValueSensor = analogRead(analogInPin);
  // map it to the range of the analog out:
  Value2311 = map(ValueSensor, 0, 1023, 0, 255);
  ValueLED = map(ValueSensor, 0, 1023, 0, 63);
  ValueVFD = map(ValueSensor, 0, 1023, 10, 100);
  // change the analog out value:
  LEDBright();
  VFDBright();

  // print the results to the serial monitor:
  String(ValueSensor).toCharArray ( outbuff[0], String(ValueSensor).length()+1 );
  String(Value2311).toCharArray ( outbuff[1], String(Value2311).length()+1 );
  vfd.print("sensor:");
  vfd.print(outbuff[0]);
  vfd.println("     ");
  vfd.print("output:");
  vfd.print(outbuff[1]);
  vfd.println("     ");
  autorun();
  //warn();
  //warn2();
}



